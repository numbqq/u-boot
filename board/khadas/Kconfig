## board/khadas/Kconfig
```kconfig
config KVIM
	bool "Support Khadas VIM SBC board"
	default n

config KVIM2
	bool "Support Khadas VIM2 SBC board"
	default n

config EP_BOX
	bool "Support Khadas EP-BOX board"
	default n

if KVIM
source "board/khadas/kvim/Kconfig"
endif

if KVIM2
source "board/khadas/kvim2/Kconfig"
endif

if EP_BOX
source "board/khadas/ep-box/Kconfig"
endif
```

## board/khadas/ep-box/Kconfig
```kconfig
if TARGET_MESON_GX

config SYS_CPU
	string
	default "armv8"

config SYS_BOARD
	string
	default "ep-box"

config SYS_VENDOR
	string
	default "khadas"

config SYS_SOC
	string
	default "gxl"

config SYS_CONFIG_NAME
	default "ep-box"

endif
```
